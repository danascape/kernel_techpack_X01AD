## Kconfig
```kconfig
menu "Asus X00P platform"
	depends on ARCH_SDM632

config MACH_ASUS_X01AD
	bool "Asus X01AD"
	depends on ARCH_SDM632
	help
	  Support for Asus X01AD

source "techpack/x01ad/touchscreen/Kconfig"

endmenu
```

## touchscreen/Kconfig
```kconfig
menu "Touchscreen"
	depends on INPUT_TOUCHSCREEN

source "techpack/x01ad/touchscreen/NVT_TP_Driver/Kconfig"
source "techpack/x01ad/touchscreen/ipio_touch_driver-v1.0.3.5/Kconfig"

endmenu
```
